## blinking/main/Kconfig.projbuild
```kconfig
# Blinky Multi-LED Configuration

menu "LED Controller Configuration"

    orsource "$IDF_PATH/examples/common_components/env_caps/$IDF_TARGET/Kconfig.env_caps"

    # LED type selection
    choice BLINK_LED_TYPE
        prompt "LED hardware type"
        default BLINK_LED_GPIO
        help
            Select between discrete GPIO-controlled LEDs or addressable LED strip.
            GPIO mode supports individual control of three LEDs.

        config BLINK_LED_GPIO
            bool "GPIO LEDs"
            help
                Three discrete LEDs connected to individual GPIO pins

        config BLINK_LED_STRIP
            bool "Addressable LED Strip"
            help
                WS2812-style addressable RGB strip with configurable LED count
    endchoice

    # GPIO configuration
    if BLINK_LED_GPIO
        config BLINK_GPIO_1
            int "Primary LED GPIO"
            range ENV_GPIO_RANGE_MIN ENV_GPIO_OUT_RANGE_MAX
            default 8
            help
                GPIO number for primary status LED (LED1)

        config BLINK_GPIO_2
            int "Secondary LED GPIO"
            range ENV_GPIO_RANGE_MIN ENV_GPIO_OUT_RANGE_MAX
            default 9
            help
                GPIO number for secondary status LED (LED2)

        config BLINK_GPIO_3
            int "Tertiary LED GPIO"
            range ENV_GPIO_RANGE_MIN ENV_GPIO_OUT_RANGE_MAX
            default 10
            help
                GPIO number for tertiary status LED (LED3)
    endif

    # LED strip configuration
    if BLINK_LED_STRIP
        choice BLINK_LED_STRIP_BACKEND
            prompt "Strip communication protocol"
            default BLINK_LED_STRIP_BACKEND_RMT if SOC_RMT_SUPPORTED
            default BLINK_LED_STRIP_BACKEND_SPI
            help
                Select low-level peripheral for LED strip communication

            config BLINK_LED_STRIP_BACKEND_RMT
                depends on SOC_RMT_SUPPORTED
                bool "RMT (Recommended)"
                help
                    Use RMT peripheral for precise timing control

            config BLINK_LED_STRIP_BACKEND_SPI
                bool "SPI (Fallback)"
                help
                    Use SPI peripheral as alternative communication method
        endchoice

        config BLINK_STRIP_GPIO
            int "LED strip data GPIO"
            range ENV_GPIO_RANGE_MIN ENV_GPIO_OUT_RANGE_MAX
            default 8
            help
                Data line GPIO for LED strip connection

        config BLINK_STRIP_LED_COUNT
            int "Number of LEDs in strip"
            range 1 256
            default 3
            help
                Configure the number of addressable LEDs in the strip
    endif

    # Timing configuration
    config BLINK_PERIOD_MS
        int "Blink cycle duration (ms)"
        range 10 3600000
        default 1000
        help
            Full cycle duration for blinking pattern in milliseconds

endmenu
```

## blinking/sdkconfig.defaults.esp32
```kconfig
# ESP32-WROOM-32E Default Configuration
CONFIG_BLINK_LED_GPIO=y
CONFIG_BLINK_GPIO_1=12
CONFIG_BLINK_GPIO_2=13
CONFIG_BLINK_GPIO_3=14
CONFIG_BLINK_PERIOD_MS=750
CONFIG_LOG_DEFAULT_LEVEL_INFO=y
CONFIG_ESP32_WIFI_ENABLED=n
```
